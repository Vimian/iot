## assignment_2/src/main/Kconfig.projbuild
```kconfig
menu "Configuration"

  config WIFI_SSID
    string "WiFi SSID"
    default "myssid"

  config WIFI_PASS
    string "WiFi Password"
    default "mypassword"

  config MQTT_BROKER
    string "MQTT Broker URL"
    default "mqtt://broker.hivemq.com"

  config MQTT_COMMAND_TOPIC
    string "MQTT Command Topic"
    default "org/sdu/2024/iot/my/name/command"

  config MQTT_RESPONSE_TOPIC
    string "MQTT Response Topic"
    default "org/sdu/2024/iot/my/name/response"
    
endmenu
```
